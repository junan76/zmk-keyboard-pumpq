## boards/pumpq/skystar/Kconfig.defconfig
```kconfig
if BOARD_SKYSTAR

config ZMK_KEYBOARD_NAME
    default "Pumpq Skystar"

config ZMK_KSCAN_MATRIX_POLLING
    default y

endif
```

## boards/pumpq/skystar/board.yml
```yaml
board:
  name: skystar
  vendor: pumpq
  socs:
    - name: stm32f407xx
      variants:
      - name: zmk
```

## boards/pumpq/skystar/skystar_stm32f407xx_zmk_defconfig
```kconfig
# enable pinctrl
CONFIG_PINCTRL=y

# enable GPIO
CONFIG_GPIO=y

# clock configuration
CONFIG_CLOCK_CONTROL=y

CONFIG_ZMK_USB=y
```
